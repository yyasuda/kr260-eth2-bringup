## boot/meta-gem2-j10b/conf/layer.conf
```bitbake
BBPATH .= ":${LAYERDIR}"

BBFILES += "${LAYERDIR}/recipes-*/*/*.bb ${LAYERDIR}/recipes-*/*/*.bbappend"

BBFILE_COLLECTIONS += "gem2_j10b"
BBFILE_PATTERN_gem2_j10b = "^${LAYERDIR}/"
BBFILE_PRIORITY_gem2_j10b = "8"

LAYERSERIES_COMPAT_gem2_j10b = "scarthgap"
LAYERDEPENDS_gem2_j10b = "core xilinx-standalone-sdt"
```
